## drivers/soc/oplus/Kconfig
```kconfig
source "drivers/soc/oplus/device_info/Kconfig"
source "drivers/soc/oplus/mtk_boot/Kconfig"
source "drivers/soc/oplus/mtk_boot_reason/Kconfig"
source "drivers/soc/oplus/oplus_project/Kconfig"
```

## drivers/soc/oplus/oplus_custom/Kconfig
```kconfig
# SPDX-License-Identifier: GPL-2.0-only
# Copyright (C) 2018-2020 Oplus. All rights reserved.
config OPLUS_FEATURE_CUSTOM
  tristate "config oplus custom for kernel"
  default n
  help
    define this config to define oplus project
```

## drivers/soc/oplus/system/Kconfig
```kconfig
# SPDX-License-Identifier: GPL-2.0-only
# Copyright (C) 2018-2020 Oplus. All rights reserved.
config OPLUS_SYSTEM_KERNEL
  bool "config oplus system feature "
  default y
  help
	define this config to add oplus sytstem kernel feature

config OPPO_ARCH_FILE
  bool "for build directory oplus"
  help
	say Y to buid in

config OPPO_COMMON_SOFT
  bool "config oplus common software"
  select OPPO_ARCH_FILE
  help
	define this config to get project verion from sharemem.
	Maybe this value is from CDT or dynamic identify by hardware
	id.

config OPPO_DEVICE_IFNO
  bool "config devinfo"
  tristate "config oppo devinfo"
  select OPPO_ARCH_FILE
  help
	define this config to compile devinfo.c for device register
		.
config OPLUS_BUG_STABILITY_EFFECTON_QGKI
  tristate "config stability bug fixing effect on qgki"
  help
	define this config to fix stability bug only effect on qgki

config OPLUS_FEATURE_DETAILHEAD
  tristate "config detail kmsg"
    help
        define this config to add cpu number and current id and current comm to kmsg

source "drivers/soc/oplus/system/oplus_project/Kconfig"
source "drivers/soc/oplus/system/oplus_pmic_monitor_mtk/Kconfig"
source "drivers/soc/oplus/system/project_info/Kconfig"
source "drivers/soc/oplus/system/cmdline_parser/Kconfig"

#ifdef OPLUS_FEATURE_MISC
#terry.zhong@OPTI.Kernel.Stability, 2020/09/7, enable oplus misc feature
source "drivers/soc/oplus/system/misc/Kconfig"
#endif /* OPLUS_FEATURE_MISC */

#ifdef OPLUS_FEATURE_LOG_CORE
source "drivers/soc/oplus/system/olc/Kconfig"
#endif /* OPLUS_FEATURE_LOG_CORE */
```

## sound/soc/codecs/audio/Kconfig
```kconfig
#
# oplus extend audio codec configuration
#

#ifdef OPLUS_ARCH_EXTENDS
config SND_SOC_CODEC_AW88264
        tristate "SoC Audio for awinic aw88264series"
        depends on I2C
        help
          This option enables support for aw88264series Smart PA.
#endif /* OPLUS_ARCH_EXTENDS */
```
